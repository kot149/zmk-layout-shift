#include <dt-bindings/zmk/keys.h>
#include <dt-bindings/zmk/layout_shift.h>

/ {
    /omit-if-no-ref/ layout_shift_map_us_to_jis: layout_shift_map_us_to_jis {
        compatible = "zmk,layout-shift-map";
        mappings = <
            EQUAL             UNDERSCORE        (LAYOUT_SHIFT_OPTIONAL_CTRL | LAYOUT_SHIFT_OPTIONAL_ALT | LAYOUT_SHIFT_OPTIONAL_GUI)
            CARET             EQUAL             (LAYOUT_SHIFT_OPTIONAL_CTRL | LAYOUT_SHIFT_OPTIONAL_ALT | LAYOUT_SHIFT_OPTIONAL_GUI)
            TILDE             PLUS              (LAYOUT_SHIFT_OPTIONAL_CTRL | LAYOUT_SHIFT_OPTIONAL_ALT | LAYOUT_SHIFT_OPTIONAL_GUI)
            AT_SIGN           LEFT_BRACKET      (LAYOUT_SHIFT_OPTIONAL_CTRL | LAYOUT_SHIFT_OPTIONAL_ALT | LAYOUT_SHIFT_OPTIONAL_GUI)
            GRAVE             LEFT_BRACE        (LAYOUT_SHIFT_OPTIONAL_CTRL | LAYOUT_SHIFT_OPTIONAL_ALT | LAYOUT_SHIFT_OPTIONAL_GUI)
            LEFT_BRACKET      RIGHT_BRACKET     (LAYOUT_SHIFT_OPTIONAL_CTRL | LAYOUT_SHIFT_OPTIONAL_ALT | LAYOUT_SHIFT_OPTIONAL_GUI)
            RIGHT_BRACKET     BACKSLASH         (LAYOUT_SHIFT_OPTIONAL_CTRL | LAYOUT_SHIFT_OPTIONAL_ALT | LAYOUT_SHIFT_OPTIONAL_GUI)
            LEFT_BRACE        RIGHT_BRACE       (LAYOUT_SHIFT_OPTIONAL_CTRL | LAYOUT_SHIFT_OPTIONAL_ALT | LAYOUT_SHIFT_OPTIONAL_GUI)
            RIGHT_BRACE       PIPE              (LAYOUT_SHIFT_OPTIONAL_CTRL | LAYOUT_SHIFT_OPTIONAL_ALT | LAYOUT_SHIFT_OPTIONAL_GUI)
            PLUS              COLON             (LAYOUT_SHIFT_OPTIONAL_CTRL | LAYOUT_SHIFT_OPTIONAL_ALT | LAYOUT_SHIFT_OPTIONAL_GUI)
            COLON             SINGLE_QUOTE      (LAYOUT_SHIFT_OPTIONAL_CTRL | LAYOUT_SHIFT_OPTIONAL_ALT | LAYOUT_SHIFT_OPTIONAL_GUI)
            ASTERISK          DOUBLE_QUOTES     (LAYOUT_SHIFT_OPTIONAL_CTRL | LAYOUT_SHIFT_OPTIONAL_ALT | LAYOUT_SHIFT_OPTIONAL_GUI)
            DOUBLE_QUOTES     AT_SIGN           (LAYOUT_SHIFT_OPTIONAL_CTRL | LAYOUT_SHIFT_OPTIONAL_ALT | LAYOUT_SHIFT_OPTIONAL_GUI)
            AMPERSAND         CARET             (LAYOUT_SHIFT_OPTIONAL_CTRL | LAYOUT_SHIFT_OPTIONAL_ALT | LAYOUT_SHIFT_OPTIONAL_GUI)
            SINGLE_QUOTE      AMPERSAND         (LAYOUT_SHIFT_OPTIONAL_CTRL | LAYOUT_SHIFT_OPTIONAL_ALT | LAYOUT_SHIFT_OPTIONAL_GUI)
            LEFT_PARENTHESIS  ASTERISK          (LAYOUT_SHIFT_OPTIONAL_CTRL | LAYOUT_SHIFT_OPTIONAL_ALT | LAYOUT_SHIFT_OPTIONAL_GUI)
            RIGHT_PARENTHESIS LEFT_PARENTHESIS  (LAYOUT_SHIFT_OPTIONAL_CTRL | LAYOUT_SHIFT_OPTIONAL_ALT | LAYOUT_SHIFT_OPTIONAL_GUI)
            UNDERSCORE        LS(0x87)          (LAYOUT_SHIFT_OPTIONAL_CTRL | LAYOUT_SHIFT_OPTIONAL_ALT | LAYOUT_SHIFT_OPTIONAL_GUI)
            BACKSLASH         0x89              (LAYOUT_SHIFT_OPTIONAL_CTRL | LAYOUT_SHIFT_OPTIONAL_ALT | LAYOUT_SHIFT_OPTIONAL_GUI)
            PIPE              LS(0x89)          (LAYOUT_SHIFT_OPTIONAL_CTRL | LAYOUT_SHIFT_OPTIONAL_ALT | LAYOUT_SHIFT_OPTIONAL_GUI)
        >;
    };

    /omit-if-no-ref/ layout_shift_map_dvorak: layout_shift_map_dvorak {
        compatible = "zmk,layout-shift-map";
        mappings = <
            MINUS         LEFT_BRACKET   LAYOUT_SHIFT_OPTIONAL_ALL
            EQUAL         RIGHT_BRACKET  LAYOUT_SHIFT_OPTIONAL_ALL
            Q             SINGLE_QUOTE   LAYOUT_SHIFT_OPTIONAL_ALL
            W             COMMA          LAYOUT_SHIFT_OPTIONAL_ALL
            E             DOT            LAYOUT_SHIFT_OPTIONAL_ALL
            R             P              LAYOUT_SHIFT_OPTIONAL_ALL
            T             Y              LAYOUT_SHIFT_OPTIONAL_ALL
            Y             F              LAYOUT_SHIFT_OPTIONAL_ALL
            U             G              LAYOUT_SHIFT_OPTIONAL_ALL
            I             C              LAYOUT_SHIFT_OPTIONAL_ALL
            O             R              LAYOUT_SHIFT_OPTIONAL_ALL
            P             L              LAYOUT_SHIFT_OPTIONAL_ALL
            LEFT_BRACKET  SLASH          LAYOUT_SHIFT_OPTIONAL_ALL
            RIGHT_BRACKET EQUAL          LAYOUT_SHIFT_OPTIONAL_ALL
            S             O              LAYOUT_SHIFT_OPTIONAL_ALL
            D             E              LAYOUT_SHIFT_OPTIONAL_ALL
            F             U              LAYOUT_SHIFT_OPTIONAL_ALL
            G             I              LAYOUT_SHIFT_OPTIONAL_ALL
            H             D              LAYOUT_SHIFT_OPTIONAL_ALL
            J             H              LAYOUT_SHIFT_OPTIONAL_ALL
            K             T              LAYOUT_SHIFT_OPTIONAL_ALL
            L             N              LAYOUT_SHIFT_OPTIONAL_ALL
            SEMICOLON     S              LAYOUT_SHIFT_OPTIONAL_ALL
            SINGLE_QUOTE  MINUS          LAYOUT_SHIFT_OPTIONAL_ALL
            Z             SEMICOLON      LAYOUT_SHIFT_OPTIONAL_ALL
            X             Q              LAYOUT_SHIFT_OPTIONAL_ALL
            C             J              LAYOUT_SHIFT_OPTIONAL_ALL
            V             K              LAYOUT_SHIFT_OPTIONAL_ALL
            B             X              LAYOUT_SHIFT_OPTIONAL_ALL
            N             B              LAYOUT_SHIFT_OPTIONAL_ALL
            COMMA         W              LAYOUT_SHIFT_OPTIONAL_ALL
            DOT           V              LAYOUT_SHIFT_OPTIONAL_ALL
            SLASH         Z              LAYOUT_SHIFT_OPTIONAL_ALL
        >;
    };

    /omit-if-no-ref/ layout_shift_map_swap_ctrl_cmd: layout_shift_map_swap_ctrl_cmd {
        compatible = "zmk,layout-shift-map";
        mappings = <
            LEFT_CONTROL  LEFT_COMMAND   LAYOUT_SHIFT_OPTIONAL_ALL
            LEFT_COMMAND  LEFT_CONTROL   LAYOUT_SHIFT_OPTIONAL_ALL
            RIGHT_CONTROL RIGHT_COMMAND  LAYOUT_SHIFT_OPTIONAL_ALL
            RIGHT_COMMAND RIGHT_CONTROL  LAYOUT_SHIFT_OPTIONAL_ALL
        >;
    };

};
