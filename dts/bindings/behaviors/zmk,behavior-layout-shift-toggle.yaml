## dts/bindings/behaviors/zmk,behavior-layout-shift-toggle.yaml
```yaml
# Copyright (c) 2024 The ZMK Contributors
# SPDX-License-Identifier: MIT

description: Layout shift toggle behavior

compatible: "zmk,behavior-layout-shift-toggle"

include: zero_param.yaml

properties:
  layout-maps:
    type: phandles
    required: false
    description: |
      References to layout-shift-map nodes.
      If set, this toggle controls the specified layout(s).
      If not set, all layout maps are toggled.
  toggle-mode:
    type: string
    required: false
    default: "flip"
    enum:
      - "on"
      - "off" 
      - "flip"
    description: |
      Toggle mode for the layout shift behavior:
      - "on": Turn layout shift on
      - "off": Turn layout shift off
      - "flip": Toggle layout shift state
```

## dts/bindings/zmk,layout-shift-map.yaml
```yaml
# Copyright (c) 2024 The ZMK Contributors
# SPDX-License-Identifier: MIT

description: |
  Layout shift keycode mapping table.
  Defines keycode mappings as an array of triples: (from_keycode, to_keycode, optional_modifiers).

compatible: "zmk,layout-shift-map"

properties:
  mappings:
    type: array
    required: true
    description: |
      Array of keycode mapping triples (from_keycode, to_keycode, optional_modifiers).
      Each mapping consists of three consecutive 32-bit values:
        - from_keycode: The US layout keycode to match
        - to_keycode: The target layout keycode to output
        - optional_modifiers: Bitmask of modifiers that are optional during matching
  priority:
    type: int
    default: 0
    description: |
      Application order when multiple layout shift maps are active simultaneously.
      Maps with smaller priority values are applied first; the output of one map
      becomes the input to the next. Ties fall back to devicetree declaration order.
```
