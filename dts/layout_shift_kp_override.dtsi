// Layout Shift Overlay - Replaces &kp behavior with custom implementation
// This file should be included in keyboard config to override &kp behavior

#include "layout_shift.dtsi"

/ {
    behaviors {
        // Keep the original key_press behavior for ZMK core components
        original_key_press: original_key_press {
            compatible = "zmk,behavior-key-press";
            #binding-cells = <1>;
            label = "KEY_PRESS";
        };

        // Override the existing &kp behavior to use our custom implementation
        kp: key_press {
            compatible = "zmk,behavior-layout-shift-key-press";
            #binding-cells = <1>;
            label = "LAYOUT_SHIFT_KEY_PRESS";
        };
    };
};
