## Kconfig
```kconfig
# zmk-layout-shift Kconfig

config LAYOUT_SHIFT
    bool "Layout Shift"
    default y
    help
      Enable the Layout Shift module.

if LAYOUT_SHIFT

config LAYOUT_SHIFT_MAX_PRESSED_KEYS
    int "Maximum tracked layout shift key presses"
    default 16
    range 1 255
    help
      Maximum number of simultaneous layout shift key presses to track.
      Lower values reduce RAM usage.

config LAYOUT_SHIFT_PERSISTENT_STATE
    bool "Layout Shift Persistent State"
    default y
    select SETTINGS
    help
      Enable persistent storage of layout shift state across reboots.
      This feature requires CONFIG_SETTINGS to be enabled.

endif
```
